## meta-beaglebone-optimal-product/conf/distro/optimal-qt-dashboard.conf
```bitbake
require conf/distro/optimal-tiny.conf

DISTRO      = "optimal-qt-dashboard"
DISTRO_NAME = "Optimal Qt Dashboard"
DISTROOVERRIDES = "poky:poky-tiny:optimal-tiny:optimal-qt-dashboard"

DISTRO_FEATURES_BACKFILL_CONSIDERED:append = " sysvinit"
BAD_RECOMMENDATIONS += "sysvinit sysvinit-inittab"

DISTRO_FEATURES:remove = " \
    alsa \
    x11 \
    wayland \
    opengl \
    vulkan \
    ptest \
    pulseaudio \
    bluetooth \
    3g \
    nfc \
    wifi \
    zeroconf \
    ipv6 \
    nfs \
    gobject-introspection-data \
"
MACHINE_FEATURES:remove = "alsa"
PACKAGECONFIG:remove:pn-qemu-system-native = "sdl"
```

## meta-beaglebone-optimal-product/conf/layer.conf
```bitbake
BBPATH .= ":${LAYERDIR}"
BBFILES += "${LAYERDIR}/recipes-*/*/*.bb ${LAYERDIR}/recipes-*/*/*.bbappend"

BBFILE_COLLECTIONS += "beaglebone_optimal_product"
BBFILE_PATTERN_beaglebone_optimal_product = "^${LAYERDIR}/"
BBFILE_PRIORITY_beaglebone_optimal_product = "9"

LAYERVERSION_beaglebone_optimal_product = "1"
LAYERSERIES_COMPAT_beaglebone_optimal_product = "scarthgap"

LAYERDEPENDS_beaglebone_optimal_product = "core yocto-bsp beaglebone_optimal qt6-layer"

BEAGLEBONE_OPTIMAL_PRODUCT_LAYERDIR := "${LAYERDIR}"

BSPDIR ??= "${@os.path.abspath(os.path.join(d.getVar('LAYERDIR'), '..'))}"
```

## meta-beaglebone-optimal-product/wic/beaglebone-qt-dashboard.wks
```
# A/B rootfs plus data partition; rootfs slots include baseline headroom.
part /boot --source bootimg-partition --ondisk mmcblk0 --fstype=vfat --label boot --active --align 4 --fixed-size 32 --sourceparams="loader=u-boot" --use-uuid
part / --source rootfs --ondisk mmcblk0 --fstype=ext4 --label rootfs_a --align 4 --fixed-size 256 --use-uuid
part / --source rootfs --ondisk mmcblk0 --fstype=ext4 --label rootfs_b --align 4 --fixed-size 256 --use-uuid
part /data --ondisk mmcblk0 --fstype=ext4 --label data --align 4 --fixed-size 64 --use-uuid
bootloader --configfile="beaglebone-qt-dashboard-extlinux.conf"
```

## meta-beaglebone-optimal/conf/distro/beaglebone-optimal-tiny.conf
```bitbake
require conf/distro/poky-tiny.conf
DISTRO = "beaglebone-optimal-tiny"
DISTRO_NAME = "BeagleBone Optimal Tiny"
DISTROOVERRIDES = "poky:poky-tiny:beaglebone-optimal-tiny"
INIT_MANAGER = "mdev-busybox"

# Phase 1 tiny path strips all optional distro features and adds back only what
# is boot-essential through machine/kernel metadata.
DISTRO_FEATURES_TINY = ""
DISTRO_FEATURES_NET = ""
DISTRO_FEATURES_USB = ""
DISTRO_FEATURES_USBGADGET = ""
DISTRO_FEATURES_WIFI = ""
DISTRO_FEATURES = ""

USE_NLS = "no"
IMAGE_LINGUAS = ""
POKY_DEFAULT_EXTRA_RRECOMMENDS = ""
BAD_RECOMMENDATIONS += "busybox-udhcpc"

EXTRA_IMAGE_FEATURES = ""

VIRTUAL-RUNTIME_base-utils = "busybox"
VIRTUAL-RUNTIME_base-utils-syslog = ""
VIRTUAL-RUNTIME_update-alternatives = ""
```

## meta-beaglebone-optimal/conf/distro/optimal-tiny.conf
```bitbake
require conf/distro/poky-tiny.conf
DISTRO = "optimal-tiny"
DISTRO_NAME = "Optimal Tiny"
DISTROOVERRIDES = "poky:poky-tiny:optimal-tiny"
INIT_MANAGER = "none"

# Phase 1 tiny path strips all optional distro features and adds back only what
# is boot-essential through machine/kernel metadata.
DISTRO_FEATURES_TINY = ""
DISTRO_FEATURES_NET = ""
DISTRO_FEATURES_USB = ""
DISTRO_FEATURES_USBGADGET = ""
DISTRO_FEATURES_WIFI = ""
DISTRO_FEATURES = ""

USE_NLS = "no"
IMAGE_LINGUAS = ""
POKY_DEFAULT_EXTRA_RRECOMMENDS = ""
BAD_RECOMMENDATIONS += "busybox-udhcpc"

EXTRA_IMAGE_FEATURES = ""

VIRTUAL-RUNTIME_base-utils = "busybox"
VIRTUAL-RUNTIME_base-utils-syslog = ""
VIRTUAL-RUNTIME_update-alternatives = ""
VIRTUAL-RUNTIME_dev_manager = ""
```

## meta-beaglebone-optimal/conf/layer.conf
```bitbake
BBPATH .= ":${LAYERDIR}"
BBFILES += "${LAYERDIR}/recipes-*/*/*.bb ${LAYERDIR}/recipes-*/*/*.bbappend"

BBFILE_COLLECTIONS += "beaglebone_optimal"
BBFILE_PATTERN_beaglebone_optimal = "^${LAYERDIR}/"
BBFILE_PRIORITY_beaglebone_optimal = "8"

LAYERVERSION_beaglebone_optimal = "1"
LAYERSERIES_COMPAT_beaglebone_optimal = "scarthgap"

LAYERDEPENDS_beaglebone_optimal = "core yoctobsp"
```

## meta-beaglebone-optimal/conf/machine/beaglebone-black-optimal-qt-dashboard-dev.conf
```bitbake
#@TYPE: Machine
#@NAME: beaglebone-black-optimal-qt-dashboard-dev
#@DESCRIPTION: DEV-ONLY netboot variant of qt-dashboard (TFTP+NFS).

require conf/machine/beaglebone-black-optimal-tiny.conf

MACHINEOVERRIDES =. "beaglebone-black-optimal-qt-dashboard:"
MACHINEOVERRIDES =. "beaglebone-black-optimal-tiny:"

INITRAMFS_IMAGE = ""
INITRAMFS_IMAGE_BUNDLE = "0"

DTB_FILES = "am335x-boneblack-optimal-qt-dashboard.dtb"
KERNEL_DEVICETREE = "ti/omap/am335x-boneblack-optimal-qt-dashboard.dtb"

UBOOT_EXTLINUX_INSTALL = "1"
IMAGE_BOOT_FILES = "u-boot.${UBOOT_SUFFIX} ${SPL_BINARY} ${KERNEL_IMAGETYPE} ${DTB_FILES}"

WKS_FILE = "beaglebone-qt-dashboard.wks"

DISTRO_FEATURES:append = " optimal-gpio-leds optimal-i2c2-bus optimal-rtc-ds3231 optimal-sht3x optimal-bh1750 optimal-ab-update optimal-netboot-dev optimal-usb-gadget"
OPTIMAL_REQUIRED_FEATURES = "optimal-gpio-leds optimal-i2c2-bus optimal-rtc-ds3231 optimal-sht3x optimal-bh1750 optimal-ab-update optimal-netboot-dev optimal-usb-gadget"
```

## meta-beaglebone-optimal/conf/machine/beaglebone-black-optimal-qt-dashboard-noab.conf
```bitbake
#@TYPE: Machine
#@NAME: beaglebone-black-optimal-qt-dashboard-noab
#@DESCRIPTION: Product-side Qt dashboard machine without A/B/OTA - single rootfs.

require conf/machine/beaglebone-black-optimal-tiny.conf

MACHINEOVERRIDES =. "beaglebone-black-optimal-qt-dashboard:"
MACHINEOVERRIDES =. "beaglebone-black-optimal-tiny:"

INITRAMFS_IMAGE = ""
INITRAMFS_IMAGE_BUNDLE = "0"

DTB_FILES = "am335x-boneblack-optimal-qt-dashboard.dtb"
KERNEL_DEVICETREE = "ti/omap/am335x-boneblack-optimal-qt-dashboard.dtb"

UBOOT_EXTLINUX_INSTALL = "1"
IMAGE_BOOT_FILES = "u-boot.${UBOOT_SUFFIX} ${SPL_BINARY} ${KERNEL_IMAGETYPE} ${DTB_FILES}"

WKS_FILE = "beaglebone-qt-dashboard-noab.wks"

DISTRO_FEATURES:append = " optimal-gpio-leds optimal-i2c2-bus optimal-rtc-ds3231 optimal-sht3x optimal-bh1750"
OPTIMAL_REQUIRED_FEATURES = "optimal-gpio-leds optimal-i2c2-bus optimal-rtc-ds3231 optimal-sht3x optimal-bh1750"
```

## meta-beaglebone-optimal/conf/machine/beaglebone-black-optimal-tiny.conf
```bitbake
#@TYPE: Machine
#@NAME: beaglebone-black-optimal-tiny
#@DESCRIPTION: Tiny BeagleBone Black machine for the initramfs path

require conf/machine/include/arm/armv7a/tune-cortexa8.inc

DEFAULTTUNE ?= "cortexa8hf-neon"

SERIAL_CONSOLES ?= "115200;ttyS0"
INITRAMFS_IMAGE = "core-image-optimal-tiny-initramfs"
INITRAMFS_IMAGE_BUNDLE = "1"

PREFERRED_PROVIDER_virtual/kernel ?= "linux-yocto-tiny"
PREFERRED_VERSION_linux-yocto-tiny ?= "6.6%"
PREFERRED_PROVIDER_virtual/bootloader ?= "u-boot"

KERNEL_IMAGETYPE = "zImage"
KERNEL_DEVICETREE = "ti/omap/am335x-boneblack-optimal-tiny.dtb"

SPL_BINARY = "MLO"
UBOOT_SUFFIX = "img"
UBOOT_MACHINE = "am335x_evm_defconfig"

MACHINE_FEATURES = ""
MACHINE_ESSENTIAL_EXTRA_RDEPENDS = ""
MACHINE_EXTRA_RRECOMMENDS = ""

EXTRA_IMAGEDEPENDS += "virtual/bootloader"
```
